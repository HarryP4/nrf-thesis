## boards/arm/nrf52840_dk/Kconfig.board
```kconfig
# Copyright (c) 2023 Nordic Semiconductor ASA
# SPDX-License-Identifier: Apache-2.0

config BOARD_NRF52840_DK
	bool "nRf52840 DK"
	depends on SOC_NRF52840_QIAA
```
